## Kconfig.projbuild
```kconfig
menu "Arduino Configuration"

config ENABLE_ARDUINO_DEPENDS
    bool
    select LWIP_SO_RCVBUF
    select ETHERNET
    select WIFI_ENABLED
    select ESP32_PHY_CALIBRATION_AND_DATA_STORAGE if IDF_TARGET_ESP32
    select MEMMAP_SMP
    default "y"

config ARDUINO_ISR_IRAM
    bool "Run interrupts in IRAM"
    default "n"
    help
        Enabling this option will Attach all interrupts with the IRAm flag.
        It will also make some HAL function, like, digitalRead/Write and more
				be loaded into IRAM for access inside ISRs.
				Beware that this is a very dangerous setting. Enable it only if you
				are fully aware of the consequences.

config DISABLE_HAL_LOCKS
    bool "Disable mutex locks for HAL"
    default "n"
    help
        Enabling this option will run all hardware abstraction without locks.
        While communication with external hardware will be faster, you need to
        make sure that there is no option to use the same bus from another thread
        or interrupt at the same time. Option is best used with Arduino enabled
        and code implemented only in setup/loop and Arduino callbacks

menu "Debug Log Configuration"
choice ARDUHAL_LOG_DEFAULT_LEVEL
    bool "Default log level"
    default ARDUHAL_LOG_DEFAULT_LEVEL_ERROR
    help
        Specify how much output to see in logs by default.

config ARDUHAL_LOG_DEFAULT_LEVEL_NONE
    bool "No output"
config ARDUHAL_LOG_DEFAULT_LEVEL_ERROR
    bool "Error"
config ARDUHAL_LOG_DEFAULT_LEVEL_WARN
    bool "Warning"
config ARDUHAL_LOG_DEFAULT_LEVEL_INFO
    bool "Info"
config ARDUHAL_LOG_DEFAULT_LEVEL_DEBUG
    bool "Debug"
config ARDUHAL_LOG_DEFAULT_LEVEL_VERBOSE
    bool "Verbose"
endchoice

config ARDUHAL_LOG_DEFAULT_LEVEL
    int
    default 0 if ARDUHAL_LOG_DEFAULT_LEVEL_NONE
    default 1 if ARDUHAL_LOG_DEFAULT_LEVEL_ERROR
    default 2 if ARDUHAL_LOG_DEFAULT_LEVEL_WARN
    default 3 if ARDUHAL_LOG_DEFAULT_LEVEL_INFO
    default 4 if ARDUHAL_LOG_DEFAULT_LEVEL_DEBUG
    default 5 if ARDUHAL_LOG_DEFAULT_LEVEL_VERBOSE

config ARDUHAL_LOG_COLORS
    bool "Use ANSI terminal colors in log output"
    default "n"
    help
        Enable ANSI terminal color codes in bootloader output.
        In order to view these, your terminal program must support ANSI color codes.

config ARDUHAL_ESP_LOG
    bool "Forward ESP_LOGx to Arduino log output"
    default "n"
    help
        This option will redefine the ESP_LOGx macros to Arduino's log_x macros.
        To enable for your application, add the follwing after your includes:
        #ifdef ARDUINO_ARCH_ESP32
        #include "esp32-hal-log.h"
        #endif

endmenu

config ARDUINO_SELECTIVE_COMPILATION
    bool "Include only specific Arduino libraries"
    default n

config ARDUINO_SELECTIVE_FS
    bool "Enable FS"
    depends on ARDUINO_SELECTIVE_COMPILATION
    default y

config ARDUINO_SELECTIVE_SPI
    bool "Enable SPI"
    depends on ARDUINO_SELECTIVE_COMPILATION
    default y

config ARDUINO_SELECTIVE_SPIFFS
    bool "Enable SPIFFS"
    depends on ARDUINO_SELECTIVE_COMPILATION
    select ARDUINO_SELECTIVE_FS
    default y

config ARDUINO_SELECTIVE_Wire
    bool "Enable Wire"
    depends on ARDUINO_SELECTIVE_COMPILATION
    default y


endmenu
```
